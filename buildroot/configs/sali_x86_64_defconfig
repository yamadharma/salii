## buildroot/configs/sali_x86_64_defconfig
```kconfig
BR2_x86_64=y
BR2_TOOLCHAIN_BUILDROOT_GLIBC=y
BR2_KERNEL_HEADERS_5_10=y
BR2_TOOLCHAIN_BUILDROOT_CXX=y
BR2_TARGET_GENERIC_HOSTNAME="sali"
BR2_TARGET_GENERIC_ISSUE="Welcome to S(URF) A(utomatic) L(inux) I(nstaller)"
BR2_TARGET_GENERIC_PASSWD_SHA512=y
BR2_ROOTFS_DEVICE_CREATION_DYNAMIC_EUDEV=y
BR2_TARGET_GENERIC_ROOT_PASSWD="SaliRoot"
BR2_ROOTFS_OVERLAY="$(BR2_EXTERNAL_SALI_PATH)/board/sali/common/rootfs_overlay"
BR2_LINUX_KERNEL=y
BR2_LINUX_KERNEL_USE_CUSTOM_CONFIG=y
BR2_LINUX_KERNEL_CUSTOM_CONFIG_FILE="$(BR2_EXTERNAL_SALI_PATH)/board/sali/x86_64/linux.config"
BR2_LINUX_KERNEL_NEEDS_HOST_OPENSSL=y
BR2_LINUX_KERNEL_NEEDS_HOST_LIBELF=y
BR2_PACKAGE_BUSYBOX_CONFIG="$(BR2_EXTERNAL_SALI_PATH)/board/sali/common/busybox.config"
BR2_PACKAGE_BUSYBOX_SHOW_OTHERS=y
BR2_PACKAGE_KEXEC=y
BR2_PACKAGE_KEXEC_ZLIB=y
BR2_PACKAGE_GIT=y
BR2_PACKAGE_JQ=y
BR2_PACKAGE_DOSFSTOOLS=y
BR2_PACKAGE_DOSFSTOOLS_FSCK_FAT=y
BR2_PACKAGE_DOSFSTOOLS_MKFS_FAT=y
BR2_PACKAGE_E2FSPROGS=y
BR2_PACKAGE_XFSPROGS=y
BR2_PACKAGE_ACPID=y
BR2_PACKAGE_DBUS=y
BR2_PACKAGE_LSSCSI=y
BR2_PACKAGE_LVM2=y
BR2_PACKAGE_LVM2_LVMETAD=y
BR2_PACKAGE_MDADM=y
BR2_PACKAGE_PARTED=y
BR2_PACKAGE_USBUTILS=y
BR2_PACKAGE_LIBOPENSSL_BIN=y
BR2_PACKAGE_LIBNL=y
BR2_PACKAGE_LIBNL_TOOLS=y
BR2_PACKAGE_NCURSES_TARGET_PROGS=y
BR2_PACKAGE_READLINE=y
BR2_PACKAGE_BC=y
BR2_PACKAGE_CTORRENT=y
BR2_PACKAGE_IPERF3=y
BR2_PACKAGE_IPROUTE2=y
BR2_PACKAGE_IPUTILS=y
BR2_PACKAGE_OPENSSH=y
BR2_PACKAGE_RSYNC=y
BR2_PACKAGE_TRANSMISSION=y
BR2_PACKAGE_TRANSMISSION_CLI=y
BR2_PACKAGE_TRANSMISSION_DAEMON=y
BR2_PACKAGE_UDPCAST=y
BR2_PACKAGE_UDPCAST_SENDER=y
BR2_PACKAGE_UDPCAST_RECEIVER=y
BR2_PACKAGE_FILE=y
BR2_PACKAGE_EFIVAR=y
BR2_PACKAGE_SCRUB=y
BR2_PACKAGE_TAR=y
BR2_PACKAGE_UTIL_LINUX_EJECT=y
BR2_PACKAGE_UTIL_LINUX_HWCLOCK=y
BR2_PACKAGE_UTIL_LINUX_KILL=y
BR2_TARGET_ROOTFS_CPIO=y
# BR2_TARGET_ROOTFS_TAR is not set
BR2_PACKAGE_HOST_E2FSPROGS=y
BR2_PACKAGE_HOST_GENIMAGE=y
```

## client/Config.in
```kconfig
source "$BR2_EXTERNAL_SALI_PATH/package/aria2/Config.in"
#source "$BR2_EXTERNAL_SALI/package/lsscsi/Config.in"
#source "$BR2_EXTERNAL_SALI/package/scrub/Config.in"
```

## client/package/lsscsi/Config.in
```kconfig
config BR2_PACKAGE_LSSCSI
	bool "lsscsi"
	help
       The lsscsi command lists information about SCSI devices in Linux. Using SCSI terminology, lsscsi lists SCSI logical units (or SCSI targets when the '--transport' option is given). The default action is to produce one line of output for each SCSI device currently attached to the system.
```
