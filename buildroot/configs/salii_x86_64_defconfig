## buildroot/configs/salii_x86_64_defconfig
```kconfig
BR2_x86_64=y
BR2_BINUTILS_VERSION_2_43_X=y
BR2_GCC_VERSION_14_X=y
BR2_TOOLCHAIN_BUILDROOT_CXX=y
BR2_WGET="wget --passive-ftp -nd -t 3"
BR2_BACKUP_SITE="http://sources.buildroot.net"
BR2_OPTIMIZE_S=y
BR2_SSP_NONE=y
BR2_RELRO_NONE=y
BR2_FORTIFY_SOURCE_NONE=y
BR2_TARGET_GENERIC_HOSTNAME="salii"
BR2_TARGET_GENERIC_ISSUE="Welcome to S(URF) A(utomatic) L(inux) I(nstaller)"
BR2_TARGET_GENERIC_PASSWD_SHA512=y
BR2_ROOTFS_DEVICE_CREATION_DYNAMIC_EUDEV=y
BR2_TARGET_GENERIC_ROOT_PASSWD="SaliiRoot"
BR2_SYSTEM_BIN_SH_BASH=y
BR2_ENABLE_LOCALE_WHITELIST="C en_US ru_RU"
BR2_SYSTEM_ENABLE_NLS=y
BR2_ROOTFS_OVERLAY="$(BR2_EXTERNAL_SALII_PATH)/board/salii/common/rootfs_overlay"
BR2_LINUX_KERNEL=y
BR2_LINUX_KERNEL_USE_CUSTOM_CONFIG=y
BR2_LINUX_KERNEL_CUSTOM_CONFIG_FILE="$(BR2_EXTERNAL_SALII_PATH)/board/salii/x86_64/linux.config"
BR2_LINUX_KERNEL_ZSTD=y
BR2_LINUX_KERNEL_NEEDS_HOST_OPENSSL=y
BR2_LINUX_KERNEL_NEEDS_HOST_LIBELF=y
BR2_PACKAGE_BUSYBOX_CONFIG="$(BR2_EXTERNAL_SALII_PATH)/board/salii/common/busybox.config"
BR2_PACKAGE_BUSYBOX_SHOW_OTHERS=y
BR2_PACKAGE_BZIP2=y
BR2_PACKAGE_GZIP=y
BR2_PACKAGE_P7ZIP=y
BR2_PACKAGE_P7ZIP_7ZA=y
BR2_PACKAGE_UNZIP=y
BR2_PACKAGE_XZ=y
BR2_PACKAGE_ZIP=y
BR2_PACKAGE_ZSTD=y
BR2_PACKAGE_KEXEC=y
BR2_PACKAGE_KEXEC_ZLIB=y
BR2_PACKAGE_GIT=y
BR2_PACKAGE_JQ=y
BR2_PACKAGE_SED=y
BR2_PACKAGE_BTRFS_PROGS=y
BR2_PACKAGE_DOSFSTOOLS=y
BR2_PACKAGE_DOSFSTOOLS_FATLABEL=y
BR2_PACKAGE_DOSFSTOOLS_FSCK_FAT=y
BR2_PACKAGE_DOSFSTOOLS_MKFS_FAT=y
BR2_PACKAGE_E2FSPROGS_E2IMAGE=y
BR2_PACKAGE_E2FSPROGS_E4DEFRAG=y
BR2_PACKAGE_E2FSPROGS_FUSE2FS=y
BR2_PACKAGE_E2FSPROGS_RESIZE2FS=y
BR2_PACKAGE_E2TOOLS=y
BR2_PACKAGE_EXFAT_UTILS=y
BR2_PACKAGE_EXFATPROGS=y
BR2_PACKAGE_FIRMWARE_UTILS=y
BR2_PACKAGE_FWUP=y
BR2_PACKAGE_GENEXT2FS=y
BR2_PACKAGE_NTFS_3G=y
BR2_PACKAGE_NTFS_3G_ENCRYPTED=y
BR2_PACKAGE_NTFS_3G_NTFSPROGS=y
BR2_PACKAGE_XFSPROGS=y
BR2_PACKAGE_ACPID=y
BR2_PACKAGE_DBUS=y
BR2_PACKAGE_FWUPD=y
BR2_PACKAGE_FWUPD_EFI=y
BR2_PACKAGE_GPTFDISK=y
BR2_PACKAGE_GPTFDISK_GDISK=y
BR2_PACKAGE_GPTFDISK_SGDISK=y
BR2_PACKAGE_GPTFDISK_CGDISK=y
BR2_PACKAGE_LSSCSI=y
BR2_PACKAGE_LVM2=y
BR2_PACKAGE_MDADM=y
BR2_PACKAGE_NVME=y
BR2_PACKAGE_PARTED=y
BR2_PACKAGE_USBUTILS=y
BR2_PACKAGE_LZ4=y
BR2_PACKAGE_LZ4_PROGS=y
BR2_PACKAGE_LIBOPENSSL_BIN=y
BR2_PACKAGE_LIBCURL_CURL=y
BR2_PACKAGE_LIBNL=y
BR2_PACKAGE_LIBNL_TOOLS=y
BR2_PACKAGE_NCURSES_TARGET_PROGS=y
BR2_PACKAGE_PCRE=y
BR2_PACKAGE_PCRE_UCP=y
BR2_PACKAGE_SLANG=y
BR2_PACKAGE_BC=y
BR2_PACKAGE_CTORRENT=y
BR2_PACKAGE_IPERF3=y
BR2_PACKAGE_IPROUTE2=y
BR2_PACKAGE_IPUTILS=y
BR2_PACKAGE_OPENSSH=y
BR2_PACKAGE_RSYNC=y
BR2_PACKAGE_RTORRENT=y
BR2_PACKAGE_TRANSMISSION=y
BR2_PACKAGE_TRANSMISSION_CLI=y
BR2_PACKAGE_TRANSMISSION_DAEMON=y
BR2_PACKAGE_UDPCAST=y
BR2_PACKAGE_UDPCAST_SENDER=y
BR2_PACKAGE_UDPCAST_RECEIVER=y
BR2_PACKAGE_DASH=y
BR2_PACKAGE_FILE=y
BR2_PACKAGE_XXHASH=y
BR2_PACKAGE_EFIBOOTMGR=y
BR2_PACKAGE_SCRUB=y
BR2_PACKAGE_TAR=y
BR2_PACKAGE_UTIL_LINUX_BINARIES=y
BR2_PACKAGE_UTIL_LINUX_EJECT=y
BR2_PACKAGE_UTIL_LINUX_HWCLOCK=y
BR2_PACKAGE_UTIL_LINUX_KILL=y
BR2_PACKAGE_MC=y
BR2_PACKAGE_VIM=y
BR2_TARGET_ROOTFS_CPIO=y
BR2_TARGET_ROOTFS_CPIO_ZSTD=y
BR2_TARGET_ROOTFS_TAR_ZSTD=y
BR2_PACKAGE_HOST_E2TOOLS=y
BR2_PACKAGE_HOST_EXFATPROGS=y
BR2_PACKAGE_HOST_FWUP=y
BR2_PACKAGE_HOST_GENIMAGE=y
BR2_PACKAGE_HOST_GPTFDISK=y
BR2_PACKAGE_HOST_KMOD_GZ=y
BR2_PACKAGE_HOST_KMOD_ZSTD=y
BR2_PACKAGE_HOST_KMOD_XZ=y
BR2_PACKAGE_HOST_PYTHON3_BZIP2=y
BR2_PACKAGE_HOST_ZIP=y
BR2_PACKAGE_HOST_ZSTD=y
```
